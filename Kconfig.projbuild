## Kconfig.projbuild
```kconfig
menu "RO Controller"

config RO_TEST_HOOKS
    bool "Enable bench-only diagnostic input override"
    default n
    help
        Enables a low-priority serial diagnostic protocol used by tests/target.
        The protocol can read snapshots and substitute semantic pressure/leak
        inputs, but it cannot directly drive inlet, pump, or flush GPIOs.
        Keep disabled in production builds.

endmenu
```

## components/ro_app/Kconfig.projbuild
```kconfig
menu "RO Controller"

config RO_TEST_HOOKS
    bool "Enable RO bench-test hooks"
    default n
    help
        Enables diagnostic hooks used only by the pytest-embedded bench suite.
        Production firmware leaves these hooks disabled.

endmenu
```

## sdkconfig.defaults
```kconfig
CONFIG_IDF_TARGET="esp32s3"
CONFIG_ESPTOOLPY_FLASHSIZE_16MB=y
CONFIG_PARTITION_TABLE_CUSTOM=y
CONFIG_PARTITION_TABLE_CUSTOM_FILENAME="partitions.csv"
CONFIG_COMPILER_CXX_EXCEPTIONS=n
CONFIG_COMPILER_CXX_RTTI=n
CONFIG_ESP_TASK_WDT_EN=y
CONFIG_ESP_TASK_WDT_INIT=y
CONFIG_ESP_TASK_WDT_TIMEOUT_S=5
CONFIG_ESP_TASK_WDT_CHECK_IDLE_TASK_CPU0=y
CONFIG_ESP_TASK_WDT_CHECK_IDLE_TASK_CPU1=y
CONFIG_SPIRAM=y
CONFIG_SPIRAM_MODE_OCT=y
CONFIG_SPIRAM_SPEED_80M=y
CONFIG_SPIRAM_BOOT_INIT=y
CONFIG_ESP32S3_SPIRAM_SUPPORT=y
CONFIG_MBEDTLS_CERTIFICATE_BUNDLE=y
CONFIG_ESP_HTTPS_SERVER_ENABLE=y
CONFIG_HTTPD_WS_SUPPORT=y
CONFIG_BOOTLOADER_APP_ROLLBACK_ENABLE=y
CONFIG_ESP_COREDUMP_ENABLE_TO_FLASH=y
CONFIG_ESP_COREDUMP_DATA_FORMAT_ELF=y
CONFIG_LWIP_SNTP_MAX_SERVERS=3
CONFIG_LOG_DEFAULT_LEVEL_INFO=y
```
